## main/Kconfig.projbuild
```kconfig
menu "Project Configuration"
    config ESP_WIFI_SSID
        string "WiFi SSID"
        default "myssid"
        help
            SSID (network name) for the example to connect to.

    config ESP_WIFI_PASSWORD
        string "WiFi Password"
        default "mypassword"
        help
            WiFi password (WPA or WPA2) for the example to use.

    config ESP_MAXIMUM_RETRY
        int "Maximum retry"
        default 5
        help
            Set the Maximum retry to avoid station reconnecting to the AP unlimited when the AP is really inexistent.

    config ESP_WS2812_NUM_LED
        int "Number of LEDs"
        default 10
        help 
            Number of LEDs in the strip

    config ESP_WS2812_PIN
        int "GPIO Pin"
        default 14
        help
            GPIO pin number to which the WS2812 strip is connected
endmenu
```
